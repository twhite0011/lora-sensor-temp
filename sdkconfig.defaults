## sdkconfig.defaults
```kconfig
CONFIG_FREERTOS_HZ=1000
CONFIG_ESP_TASK_WDT_EN=n
CONFIG_LMIC_FREQ_USE_US_915=y
# CONFIG_LMIC_FREQ_USE_EU_868 is not set
CONFIG_LMIC_USE_SX1276=y
# CONFIG_LMIC_USE_SX1272 is not set
CONFIG_LMIC_DEBUG_LEVEL=1
```
